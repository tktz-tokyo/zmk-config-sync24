## config/west.yml
```yaml
manifest:
  remotes:
    - name: zmkfirmware
      url-base: https://github.com/zmkfirmware
    - name: naginata-fork
      url-base: https://github.com/tktz-tokyo
    # Additional modules containing boards/shields/custom code can be listed here as well
    # See https://docs.zephyrproject.org/3.2.0/develop/west/manifest.html#projects
  projects:
    - name: zmk
      remote: zmkfirmware
      revision: v0.3
      import: app/west.yml
    - name: zmk-naginata
      remote: naginata-fork
      revision: 71c0070
      path: modules/lib/zmk-naginata
  self:
    path: config
```
